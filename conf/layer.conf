## conf/machine/rzg3e-ea-som.conf
```bitbake
#@TYPE: Machine
#@NAME: Embedded Artists RZ/G3E SOM Board
#@DESCRIPTION: Machine configuration for Embedded Artists RZ/G3E SOM Board

require conf/machine/include/arm/armv8-2a/tune-cortexa55.inc
require conf/machine/include/rz-common.inc
require conf/machine/include/rzg3e-family.inc

# Machine configuration
MACHINE_FEATURES:append = " alsa ext2 pci serial usbgadget usbhost can"

# Trusted Firmware-A configuration
PREFERRED_VERSION_trusted-firmware-a ?= "2.10%"
TFA_PLATFORM ?= "g3e"
TFA_BOARD ?= "smarc"
TFA_UBOOT ?= "1"
TFA_BUILD_TARGET ?= "bl2 fip"
BL2_BOOT_TARGET ?= "spi mmc esd"
BL2_ADJUST_VMA ?= "0x08003600"
FIP_ADJUST_VMA ?= "0x0000"
EXTRA_IMAGEDEPENDS += " firmware-pack"

# U-Boot Configuration
UBOOT_CONFIG ??= "rzg3e-ea-som"
UBOOT_CONFIG[rzg3e-ea-som] = "rzg3e-ea-som_defconfig"
PREFERRED_PROVIDER_u-boot = "u-boot-ea"
PREFERRED_PROVIDER_virtual/bootloader = "u-boot-ea"
PREFERRED_VERSION_u-boot = "2024.07%"

IMAGE_BOOT_FILES = " \
	bl2_bp_spi-${MACHINE}.bin \
	bl2_bp_spi-${MACHINE}.srec \
	bl2_bp_mmc-${MACHINE}.bin \
	bl2_bp_mmc-${MACHINE}.srec \
	fip-${MACHINE}.bin \
	fip-${MACHINE}.srec \
	Flash_Writer_SCIF_RZG3E_CUSTOM_LPDDR4X.mot \
"

# Linux Configuration
PREFERRED_PROVIDER_virtual/kernel = "linux-ea"
PREFERRED_VERSION_linux-ea = "6.1%"
KERNEL_DEVICETREE = "\
	renesas/rzg3e-ea-som-hdmi.dtb \
	renesas/rzg3e-ea-som-lcd.dtb \
	renesas/rzg3e-ea-som-lvds0.dtb \
	renesas/rzg3e-ea-som-lvds1.dtb \
"

# Wic image
WKS_FILE = "rz-image-bootpart-esd-g3e.wks"
do_image_wic[depends] += "firmware-pack:do_deploy"
```
